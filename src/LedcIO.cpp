////
///  LedcIO.ino - Leds i/o
//

#include <Arduino.h>
#include <SimpleTimer.h>
#include "driver/ledc.h"
#include "soc/ledc_reg.h"

#include "LedDriver.h"
#include "HardwareDefs.h"

typedef struct {
  ledc_channel_config_t* config;
  int current;
  int target;
} ChanBrigthness;

void fadeTask( void *pvParameters );
/**
* 12 bits PWM to CIE Luminance conversion
* L* = 116(Y/Yn)^1/3 - 16 , Y/Yn > 0.008856
* L* = 903.3(Y/Yn), Y/Yn <= 0.008856
*/
//lookup table for 1024 CIE lab brightness corrected values with 12 bit resolution
const uint16_t CIEL_10_12[1024] = {
  0, 1, 1, 2, 2, 3, 3, 4, 4, 4, 5, 5,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 21,
  21, 22, 22, 23, 23, 23, 24, 24, 25, 25, 26, 26,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 40,
  40, 41, 41, 42, 42, 43, 43, 44, 44, 45, 45, 46,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 64,
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  4054, 4064, 4074, 4085, 4095 };


ledc_timer_config_t ledc_timer = {
    .speed_mode = LEDC_HIGH_SPEED_MODE, // timer mode
    {.duty_resolution = LEDC_TIMER_12_BIT}, // resolution of PWM duty
    .timer_num = LEDC_TIMER_0,          // timer index
    .freq_hz = LEDC_FREQUENCY           // frequency of PWM signal
  };

ledc_channel_config_t channel0Config = 
{
    .gpio_num   = YellowLedPin,
    .speed_mode = LEDC_HIGH_SPEED_MODE,
    .channel    = LEDC_CHANNEL_0,
    .intr_type  = LEDC_INTR_FADE_END,
    .timer_sel  = LEDC_TIMER_0,
    .duty       = 0
};

ledc_channel_config_t channel1Config = 
{
    .gpio_num   = WhiteLedPin,
    .speed_mode = LEDC_HIGH_SPEED_MODE,
    .channel    = LEDC_CHANNEL_1,
    .intr_type  = LEDC_INTR_FADE_END,
    .timer_sel  = LEDC_TIMER_0,
    .duty       = 0
};

ChanBrigthness brigthnessChan0 = {
  .config = &channel0Config,
  .current = 0,
  .target = 0
};

ChanBrigthness brigthnessChan1 = {
  .config = &channel1Config,
  .current = 0,
  .target = 0
};

TaskHandle_t fadeTaskHandle0;
TaskHandle_t fadeTaskHandle1;


void ledSetup() {
  pinMode(NightLedPin, OUTPUT);

  ledc_timer_config(&ledc_timer);
  ledc_channel_config(&channel0Config);
  ledc_channel_config(&channel1Config);

  ledc_fade_func_install(0);

  xTaskCreate(fadeTask, "fadeTask0", 10000, &brigthnessChan0, 2, &fadeTaskHandle0);
  xTaskCreate(fadeTask, "fadeTask1", 10000, &brigthnessChan1, 2, &fadeTaskHandle1);
}

void nightLedOn(bool on) {
  if (on) {
    digitalWrite(NightLedPin, HIGH);
  } else {
    digitalWrite(NightLedPin, LOW);
  }
}


void setBrightness(int bright, int channel) {
  switch(channel) {
    case YellowChannel:
      brigthnessChan0.target = bright;
      vTaskResume(fadeTaskHandle0);
      break;
    case WhiteChannel:
      brigthnessChan1.target = bright;
      vTaskResume(fadeTaskHandle1);
      break;
  }
}

void fadeTask( void *pvParameters ) {
ChanBrigthness* fade = (ChanBrigthness*) pvParameters;

printf("Init fade task chan %d\n", fade->config->channel);

for( ;; ) {
    while(fade->current != fade->target) {
      int time = abs(fade->target - fade->current);
      if (time < 100) time = 100;
      const int duty = CIEL_10_12[fade->target];

      // printf("Brigthness[%d] %d->%d %d t=%d\n",fade->config->channel ,fade->current, fade->target, duty, time);
      fade->current = fade->target;

      ledc_set_fade_with_time(fade->config->speed_mode, fade->config->channel, duty, time);
      ledc_fade_start(fade->config->speed_mode, fade->config->channel, LEDC_FADE_WAIT_DONE);
      // printf("duty[%d] = %d\n", fade->config->channel, ledc_get_duty(fade->config->speed_mode, fade->config->channel));
    }
    vTaskSuspend(NULL);
  }
}
